/*
    Basic of Oled
Arthor : Qian Qiyang (KisaragiAyanoo@twitter)
Date : 2015/12/01

*/


#include "includes.h"
#include <stdarg.h>
#include <stdio.h>


// ===== Variables =====

// --- Local ---
const uint8 F6x8[][6];
#define XLevelL		0x00
#define XLevelH		0x10
#define XLevel		((XLevelH&0x0F)*16+XLevelL)
#define OLED_COL	128
#define Max_Row		  64
#define	Brightness	0xCF 

#define X_WIDTH 128
#define Y_WIDTH 64



// ===== Functions Declare =====

// --- Local --- ( No need for user to use ! )

  // Basic Driver 
void Oled_WrDat(uint8 data);
void Oled_WrCmd(uint8 cmd);
void Oled_DLY_ms(uint16 ms);
void Oled_Set_Pos(uint8 x, uint8 y);

  // Hardware Interface
void Oled_SCL(u8 x);
void Oled_SDA(u8 x);
void Oled_RST(u8 x);
void Oled_DC(u8 x);




void Oled_Putstr(u8 y,u8 x,u8 ch[])
{
  uint8 c=0,i=0,j=0,t=0; 
  while (ch[t]!='\0')
    t++;
  Oled_Set_Pos(21-x-t,7-y);
  for(j=0;j<t;j++){   
    c = ch[t-1-j]-32;
    for(i=0;i<6;i++)     
      Oled_WrDat(F6x8[c][5-i]);  
  }
}
// ===== APIs Realization =====

// 可以这么用了
// Oled_Printf(0, 0, "Format %c %5d %.2f", 'a', 5, 3.14);
int Oled_Printf(u8 y, u8 x, u8 * format, ... )
{
	char buf[128];
	int length;
	va_list arg_list;

	va_start( arg_list, format );
	length = vsprintf( buf, format, arg_list );
	va_end( arg_list );

	Oled_Putstr(y, x, buf);

	return length;
}
void Oled_Putnum(u8 x,u8 y,s16 c){      
  uint8 cha[7],temp,sig=0;
  
  if (c<0){
    sig=1;
    c = -c;
  }
  
  cha[0]=' ';
  
  temp=c/10000;
  if(temp==0) cha[1]=' ';
  else cha[1]=temp+48;
  
  temp=c%10000/1000;
  if(temp==0 && cha[1]==' ') cha[2]=' ';
  else cha[2]=temp+48;
  
  temp=c%1000/100;
  if(temp==0 && cha[2]==' ') cha[3]=' ';
  else cha[3]=temp+48;
  
  temp=c%100/10;
  if(temp==0 && cha[3]==' ') cha[4]=' ';
  else cha[4]=temp+48; 
  
  temp=c%10;
  cha[5]=temp+48;  
  cha[6]='\0';
  if(sig){
    temp=6;
    while(cha[temp]!=' ')
      temp--;
    cha[temp]='-';
  }
  Oled_Putstr(x,y+1,cha);
}



void Oled_Clear(void)
{
	uint8 y,x;	
	for(y=0;y<8;y++)
	{
		Oled_WrCmd(0xb0+y);
		Oled_WrCmd(0x01);
		Oled_WrCmd(0x10); 
		for(x=0;x<X_WIDTH;x++)
			Oled_WrDat(0);
	}
}

void Oled_Setxy(u8 x, u8 y)     //OLED 设置坐标  
{   
  Oled_WrCmd(0xb0+y);  
  Oled_WrCmd(((x&0xf0)>>4)|0x10);  
  Oled_WrCmd((x&0x0f)|0x01);   
}   

void Oled_DrawBMP(u8 x0,u8 y0,u8 x1,u8 y1,u8 BMP[])//显示显示BMP图片128×64起始点坐标(x,y),x的范围0～127，y为页的范围0～7*  
{     
 unsigned int j=0;  
 unsigned char x,y;  
    
  if(y1%8==0)  
     y1=y1/8;        
  else   
     y1=y1/8+1;  
  for(y=y0;y<y1;y++)  
  {  
     Oled_Setxy(x0,y);                
     for(x=x0;x<x1;x++)  
     {        
        Oled_WrDat(BMP[j++]);            
     }  
  }  
}

void Oled_Init(void)        
{  
  PORTC->PCR[12] |= PORT_PCR_MUX(1);
  PORTC->PCR[13] |= PORT_PCR_MUX(1);
  PORTC->PCR[14] |= PORT_PCR_MUX(1);
  PORTC->PCR[15] |= PORT_PCR_MUX(1);
  PTC->PDDR |= (1<<12);
  PTC->PDDR |= (1<<13);
  PTC->PDDR |= (1<<14);
  PTC->PDDR |= (1<<15);
  
  Oled_SCL(1);
  //Oled_CS(1);	 	
	
  Oled_RST(0);
  Oled_DLY_ms(50);
  Oled_RST(1);

  Oled_WrCmd(0xae);//--turn off oled panel
  Oled_WrCmd(0x00);//---set low column address
  Oled_WrCmd(0x10);//---set high column address
  Oled_WrCmd(0x40);//--set start line address  Set Mapping RAM Display Start Line (0x00~0x3F)
  Oled_WrCmd(0x81);//--set contrast control register
  Oled_WrCmd(0xcf); // Set SEG Output Current Brightness
  Oled_WrCmd(0xa1);//--Set SEG/Column Mapping     0xa0嵍塃斀抲 0xa1惓忢
  Oled_WrCmd(0xc8);//Set COM/Row Scan Direction   0xc0忋壓斀抲 0xc8惓忢
  Oled_WrCmd(0xa6);//--set normal display
  Oled_WrCmd(0xa8);//--set multiplex ratio(1 to 64)
  Oled_WrCmd(0x3f);//--1/64 duty
  Oled_WrCmd(0xd3);//-set display offset	Shift Mapping RAM Counter (0x00~0x3F)
  Oled_WrCmd(0x00);//-not offset
  Oled_WrCmd(0xd5);//--set display clock divide ratio/oscillator frequency
  Oled_WrCmd(0xf0);//--set divide ratio, Set Clock as 100 Frames/Sec
  Oled_WrCmd(0xd9);//--set pre-charge period
  Oled_WrCmd(0xf1);//Set Pre-Charge as 15 Clocks & Discharge as 1 Clock
  Oled_WrCmd(0xda);//--set com pins hardware configuration
  Oled_WrCmd(0x12);
  Oled_WrCmd(0xdb);//--set vcomh
  Oled_WrCmd(0x40);//Set VCOM Deselect Level
  Oled_WrCmd(0x20);//-Set Page Addressing Mode (0x00/0x01/0x02)
  Oled_WrCmd(0x02);//
  Oled_WrCmd(0x8d);//--set Charge Pump enable/disable
  Oled_WrCmd(0x14);//--set(0x10) disable
  Oled_WrCmd(0xa4);// Disable Entire Display On (0xa4/0xa5)
  Oled_WrCmd(0xa6);// Disable Inverse Display On (0xa6/a7) 
  Oled_WrCmd(0xaf);//--turn on oled panel
  Oled_Clear(); 
  Oled_Set_Pos(0,0);  
	

} 



// --- Basic Driver ---

void Oled_DLY_ms(uint16 ms)
{                         
  uint16 a;
  while(ms)
  {
    a=1335;
    while(a--);
    ms--;
  }
  return;
}

void Oled_WrDat(uint8 data)
{
  uint8 i=8;
  //Oled_CS(0);;
  Oled_DC(1);;
  Oled_SCL(0);;   ;
  while(i--)
  {
    if(data&1){
      Oled_SDA(1);asm("nop");asm("nop");
    }
    else{
      Oled_SDA(0);asm("nop");asm("nop");
    }
    Oled_SCL(1); 
    asm("nop");asm("nop");asm("nop");asm("nop");        
    Oled_SCL(0);; 
    asm("nop");asm("nop");
    data>>=1;;    
  }
  //Oled_CS=1;
}

void Oled_WrCmd(uint8 cmd)
{
  uint8 i=8;
  
  //Oled_CS(0);;
  Oled_DC(0);;
  Oled_SCL(0);;
  //asm("nop");   
  while(i--)
  {
    if(cmd&0x80){Oled_SDA(1);;}
    else{Oled_SDA(0);;}
    Oled_SCL(1);;
    asm("nop");asm("nop");     
    Oled_SCL(0);;    
    cmd<<=1;;   
  }
  //Oled_CS=1;
}
void Oled_Set_Pos(uint8 x, uint8 y)
{ 
  uint8 xt,msb,lsb;
  //Oled_WrCmd(0xb0+y);
  //Oled_WrCmd(((x&0xf0)>>4)|0x10);
  //Oled_WrCmd((x&0x0f)|0x01); 
  xt = 1 + x * 6;
  lsb = xt % 16;
  msb = xt / 16 + 0x10;
  Oled_WrCmd(0xb0 + y);
  Oled_WrCmd(lsb);
  Oled_WrCmd(msb); 
} 

// --- Hardware Interface ---

void Oled_SCL(u8 x){                     //d0
  if(x)
    PTC->PSOR |= 1<<15;
  else
    PTC->PCOR |= 1<<15;
}
void Oled_SDA(u8 x){                             //d1
  if(x)
    PTC->PSOR |= 1<<14;
  else
    PTC->PCOR |= 1<<14;
}
void Oled_RST(u8 x){                     //res
  if(x)
    PTC->PSOR |= 1<<13;
  else
    PTC->PCOR |= 1<<13;
}
void Oled_DC(u8 x){                      //dc
  if(x)
    PTC->PSOR |= 1<<12;
  else
    PTC->PCOR |= 1<<12;
}


const uint8 F6x8[][6] =
{
    { 0x00, 0x00, 0x00, 0x00, 0x00, 0x00 },   // sp
    { 0x00, 0x00, 0x00, 0x2f, 0x00, 0x00 },   // !
    { 0x00, 0x00, 0x07, 0x00, 0x07, 0x00 },   // "
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    { 0x14, 0x14, 0x14, 0x14, 0x14, 0x14 }    // horiz lines
};